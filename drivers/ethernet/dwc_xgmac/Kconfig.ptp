## drivers/ethernet/dwc_xgmac/Kconfig.ptp
```kconfig
#
#Intel Hard Processor System DesignWare Cores XGMAC Ethernet controller driver
#configuration options
#
#Copyright(c) 2023, Intel Corporation
#SPDX - License - Identifier : Apache - 2.0
#

DT_COMPAT_DWC_XGMAC_PHC := snps,dwcxgmac-phc

menu "DWC XGMAC PTP clock configuration"

config ETH_DWC_XGMAC_PHC
	bool "Synopsys DesignWareCore XGMAC PTP hardware clock driver"
	default y if $(dt_compat_enabled,$(DT_COMPAT_DWC_XGMAC_PHC))
	help
	  This is a driver for the Synopsys DesignWare XGMAC PTP hardware clock, also referred to
	  as "DesignWare Cores Ethernet XGMAC". Hardware versions
	  3.x are supported.

	  Platform specific glue support is also required. This driver is
	  currently available on targets using the Intel Agilex5 series.
	depends on ETH_DWC_XGMAC

endmenu
```

## dts/bindings/ethernet/mrvl,88e151x.yaml
```yaml
# Copyright (c) 2021 IP-Logix Inc.
# SPDX-License-Identifier: Apache-2.0

# Common fields for MIIPHY devices

description: Marvel 88e151x MII PHY Venodr specific configuration

compatible: "mrvl-88e151x"

include: base.yaml

properties:
  tx-delay-en:
    type: boolean
    description: If enabled transmit clock internally delayed
  rx-delay-en:
    type: boolean
    description: If enabled receive clock internally delayed
```

## dts/bindings/ethernet/snps,dwcxgmac-phc.yaml
```yaml
# Copyright (c) 2018, Linaro Limited
# SPDX-License-Identifier: Apache-2.0

# Common fields for Ethernet devices

compatible: "snps,dwcxgmac-phc"

description: Synopsys DesignWareCore XGMAC PTP H/W Clock

include: base.yaml

properties:
  req-frq:
    type: int
    default: 4000000000
    description: |
      Maximum ethernet frame size.

  ref-frq:
    type: int
    default: 4000000000
    description: |
      Maximum ethernet frame size.

  clk-res:
    type: int
    default: 1
    description: |
      Maximum ethernet frame size.

  ts-rolovr-type:
    type: boolean
    description: |
      Maximum ethernet frame size.
```
